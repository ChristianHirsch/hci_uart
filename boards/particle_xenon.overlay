/* SPDX-License-Identifier: Apache-2.0 */

/ {
	chosen {
		zephyr,bt-c2h-uart=&uart0;
	};
};

&uart0 {
	compatible = "nordic,nrf-uarte";
	current-speed = <115200>;
	status = "okay";

	tx-pin = <6>;
	rx-pin = <8>;

	rts-pin = <42>;
	cts-pin = <43>;

	hw-flow-control;
};
